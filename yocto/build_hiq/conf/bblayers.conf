## yocto/build_hiq/conf/bblayers.conf
```bitbake
# LAYER_CONF_VERSION is increased each time build/conf/bblayers.conf
# changes incompatibly
LCONF_VERSION = "6"

BBPATH = "${TOPDIR}"
BBFILES ?= ""

BBLAYERS ?= " \
  /home/balp/src/yocto/poky/meta \
  /home/balp/src/yocto/poky/meta-yocto \
  /home/balp/src/yocto/poky/meta-yocto-bsp \
  /home/balp/src/yocto/poky/meta-raspberrypi \
  /home/balp/src/WeBuildRobots-TeamBalp/yocto/meta-meta-webuildrobots-balp \
  "
BBLAYERS_NON_REMOVABLE ?= " \
  /home/balp/src/yocto/poky/meta \
  /home/balp/src/yocto/poky/meta-yocto \
  "
```

## yocto/meta-meta-webuildrobots-balp/conf/layer.conf
```bitbake
# We have a conf and classes directory, add to BBPATH
BBPATH .= ":${LAYERDIR}"

# We have recipes-* directories, add to BBFILES
BBFILES += "${LAYERDIR}/recipes-*/*/*.bb \
	${LAYERDIR}/recipes-*/*/*.bbappend"

BBFILE_COLLECTIONS += "meta-webuildrobots-balp"
BBFILE_PATTERN_meta-webuildrobots-balp = "^${LAYERDIR}/"
BBFILE_PRIORITY_meta-webuildrobots-balp = "6"

IMAGE_FEATURES += "package-management ssh-server-openssh"
IMAGE_INSTALL_append = " curl"
IMAGE_INSTALL_append = " tbb"
IMAGE_INSTALL_append = " v4l-utils"
IMAGE_INSTALL_append = " libeigen"
IMAGE_INSTALL_append = " opencv"
```
